## config/boards/shields/dactyl-cmd/Kconfig.defconfig
```kconfig
if SHIELD_DACTYL_CMD_LEFT

config ZMK_KEYBOARD_NAME
    default "dm-cmd-left"

config ZMK_SPLIT_BLE_ROLE_CENTRAL
    default y

endif

if SHIELD_DACTYL_CMD_RIGHT

config ZMK_KEYBOARD_NAME
    default "dm-cmd-right"

endif

if SHIELD_DACTYL_CMD_LEFT || SHIELD_DACTYL_CMD_RIGHT

config ZMK_SPLIT
    default y

endif
```

## config/boards/shields/dactyl-cmd/Kconfig.shield
```kconfig
config SHIELD_DACTYL_CMD_LEFT
    def_bool $(shields_list_contains,dactyl-cmd_left)

config SHIELD_DACTYL_CMD_RIGHT
    def_bool $(shields_list_contains,dactyl-cmd_right)
```
